## main/Kconfig.projbuild
```kconfig
menu "Prone Guard Configuration"

config WIFI_SSID
    string "WiFi SSID"
    default ""
    help
        SSID for the WiFi connection. Required for operation.

config WIFI_PASSWORD
    string "WiFi Password"
    default ""
    help
        Password for the WiFi connection. Must be at least 8 characters long.

endmenu
```

## sdkconfig.defaults
```kconfig
CONFIG_MBEDTLS_HAVE_TIME=y
CONFIG_MBEDTLS_HAVE_TIME_DATE=y
CONFIG_MBEDTLS_CERTIFICATE_BUNDLE=y
CONFIG_MBEDTLS_CERTIFICATE_BUNDLE_DEFAULT_FULL=y
CONFIG_NVS_ENCRYPTION=y
CONFIG_NVS_SEC_KEY_PROTECT_USING_HMAC=y
CONFIG_NVS_SEC_HMAC_EFUSE_KEY_ID=0
CONFIG_LWIP_SNTP_UPDATE_DELAY=86400000
CONFIG_PARTITION_TABLE_CUSTOM=y
CONFIG_PARTITION_TABLE_CUSTOM_FILENAME="partitions.csv"
CONFIG_ESPTOOLPY_FLASHSIZE_16MB=y
CONFIG_SPIRAM=y
CONFIG_SPIRAM_MODE_OCT=y
CONFIG_SPIRAM_USE_MALLOC=y
CONFIG_CJSON_NESTING_LIMIT=16
CONFIG_ESP_CONSOLE_USB_SERIAL_JTAG=y
```

## tests/pairing_device/sdkconfig.defaults
```kconfig
CONFIG_IDF_TARGET="esp32s3"
CONFIG_ESP_CONSOLE_UART_DEFAULT=y
CONFIG_ESP_CONSOLE_SECONDARY_NONE=y
CONFIG_ESP_PROTOCOMM_SUPPORT_SECURITY_VERSION_2=y
# CONFIG_ESP_PROTOCOMM_SUPPORT_SECURITY_VERSION_0 is not set
# CONFIG_ESP_PROTOCOMM_SUPPORT_SECURITY_VERSION_1 is not set
CONFIG_MBEDTLS_PSA_CRYPTO_C=y
CONFIG_ESPTOOLPY_FLASHSIZE_16MB=y
CONFIG_CJSON_NESTING_LIMIT=16
CONFIG_ESP_MAIN_TASK_STACK_SIZE=12288
```
